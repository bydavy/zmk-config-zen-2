## config/west.yml
```yaml
manifest:
  remotes:
    - name: zmkfirmware
      url-base: https://github.com/bydavy
  projects:
    - name: zmk
      remote: zmkfirmware
      revision: corne-ish-zen-v2
      import: app/west.yml
  self:
    path: config
```
